## sdkconfig.defaults
```kconfig
CONFIG_FREERTOS_HZ=1000
CONFIG_ESP_INSIGHTS_ENABLED=n
CONFIG_BT_ENABLED=y
CONFIG_NIMBLE_ENABLED=y
# CONFIG_ESP_HOSTED_ENABLE_BT_NIMBLE=y
CONFIG_USE_MOCK_TRANSPORT=y
CONFIG_COMPILER_OPTIMIZATION_ASSERTIONS_ENABLE=y
# Сохранение ключей в NVS (Non-Voltage Storage)
CONFIG_BT_NIMBLE_NVS_PERSIST=y
CONFIG_LORA_TRANSPORT_SPI=y

CONFIG_LOG_DYNAMIC_LEVEL_CONTROL=y
CONFIG_LOG_MAXIMUM_LEVEL_DEBUG=y
# CONFIG_LOG_DEFAULT_LEVEL_DEBUG=y
# CONFIG_LOG_MAXIMUM_EQUALS_DEFAULT=y
CONFIG_LOG_MAXIMUM_LEVEL=4
# CONFIG_LOG_DEFAULT_LEVEL=4
```
